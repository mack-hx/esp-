## 0.1/sdkconfig.defaults
```kconfig
# ESP32-S3R8N8 平衡轮腿机械狗 SDK 配置
# 硬件：ESP32-S3R8N8 (8MB PSRAM + 8MB Flash)

CONFIG_IDF_TARGET_ESP32S3=y

# PSRAM 配置 - 8MB Octal SPI
CONFIG_ESP32S3_SPIRAM_SUPPORT=y
CONFIG_SPIRAM=y
CONFIG_SPIRAM_MODE_OCT=y
CONFIG_SPIRAM_SPEED_80M=y
CONFIG_SPIRAM_USE_CAPS_ALLOC=y
CONFIG_SPIRAM_IGNORE_NOTFOUND=y
CONFIG_SPIRAM_USE_MALLOC=y

# 系统配置
CONFIG_ESP_CONSOLE_UART_DEFAULT=y
CONFIG_ESP_MAIN_TASK_STACK_SIZE=8192
CONFIG_FREERTOS_HZ=1000

# 性能优化
CONFIG_COMPILER_OPTIMIZATION_PERF=y
CONFIG_ESP32S3_DEFAULT_CPU_FREQ_240=y

# Flash 配置
CONFIG_ESPTOOLPY_FLASHSIZE_8MB=y
```
